/*
 * OTA_Server.can — OTA (Over-The-Air) Update Server
 *
 * 역할: DoIP 경로 활성화 → UDS 0x34/0x36/0x37 펌웨어 전송 → CRC-32 검증 → Rollback
 * 채널: Ethernet (DoIP) / CAN-LS (UDS over CAN, ISO 14229-1)
 * 표준: ISO 13400-2 (DoIP), ISO 14229-1 (UDS)
 * DBC: vehicle_system.dbc — UDS_Request(0x7DF), UDS_Response(0x7E8)
 *
 * V-Model: SWE.3/SWE.6 (구현) → SWE.4 (05_Unit_Test.md 단위 테스트로 검증)
 * ISO 26262: Part 6, Clause 8 / HARA SG-08: OTA 실패 시 이전 펌웨어로 자동 복구
 */

includes
{
}

variables
{
  msTimer tOtaStep;              // OTA 단계 진행 타이머
  msTimer tResponseTimeout;      // UDS 응답 타임아웃 (5000ms)
  msTimer tBlockTx;              // 블록 전송 타이머 (100ms 간격)

  /* OTA 상태 머신 */
  int gOtaState           = 0;   // 0: Idle, 1: DoIP, 2: Session, 3: Download, 4: Transfer, 5: Exit, 6: Done
  int gOtaInProgress      = 0;   // OTA 진행 중 여부
  int gBlockSeqCounter    = 0;   // 블록 순서 카운터 (0~255)
  int gTotalBlocks        = 4;   // 총 전송 블록 수 (4KB × 4 = 16KB 시뮬레이션)
  int gCurrentBlock       = 0;   // 현재 전송 블록 번호
  int gCrcMatch           = 0;   // CRC-32 검증 결과 (0: 불일치, 1: 일치)
  int gRollbackTriggered  = 0;   // Rollback 실행 여부
  int gMaxBlockLength     = 0;   // BCM이 허용하는 최대 블록 크기

  /* UDS 서비스 ID 상수 */
  const byte SID_SESSION_CTRL    = 0x10;
  const byte SID_REQUEST_DL      = 0x34;
  const byte SID_TRANSFER_DATA   = 0x36;
  const byte SID_REQUEST_EXIT    = 0x37;

  /* DoIP 상수 */
  const word DOIP_ROUTING_ACTIVATION = 0xE001;
}

/*============================================================
 * 초기화
 *============================================================*/
on start
{
  write("[OTA_Server] 노드 시작 — OTA 대기 중");
  @OTA::otaInProgress = 0;
}

/*============================================================
 * OTA 시작 트리거 (System Variable — Panel 버튼 연동)
 *============================================================*/
on sysvar OTA::otaInProgress
{
  if (@OTA::otaInProgress == 1 && gOtaState == 0)
  {
    write("[OTA_Server] 🚀 OTA 업데이트 시작");
    gOtaState      = 1;
    gOtaInProgress = 1;
    activateDoIP();
  }
}

/*============================================================
 * Step 1: DoIP Routing Activation 전송
 *============================================================*/
void activateDoIP()
{
  message DoIP_RoutingActivation doipMsg;
  doipMsg.RoutingActivationType = 0x00;   /* Default routing */
  output(doipMsg);
  write("[OTA_Server] DoIP Routing Activation 전송 (0xE001)");
  setTimer(tResponseTimeout, 5000);
}

/*============================================================
 * Step 2: UDS 0x10 0x02 — Programming Session 진입
 *============================================================*/
void sendUDS_10_02()
{
  message UDS_Request req;
  req.byte(0) = SID_SESSION_CTRL;
  req.byte(1) = 0x02;   /* Programming Session */
  req.dlc     = 2;
  output(req);
  write("[OTA_Server] UDS 0x10 0x02 Programming Session 요청");
  setTimer(tResponseTimeout, 5000);
}

/*============================================================
 * Step 3: UDS 0x34 — 다운로드 요청
 * - 메모리 주소: 0x00010000 (BCM 펌웨어 영역)
 * - 데이터 크기: 0x4000 (16KB)
 *============================================================*/
void sendUDS_34()
{
  message UDS_Request req;
  req.byte(0) = SID_REQUEST_DL;
  req.byte(1) = 0x00;         /* dataFormatIdentifier */
  req.byte(2) = 0x44;         /* addressAndLengthFormatIdentifier: 4+4 bytes */
  req.byte(3) = 0x00;         /* memoryAddress[0] */
  req.byte(4) = 0x01;         /* memoryAddress[1] */
  req.byte(5) = 0x00;         /* memoryAddress[2] */
  req.byte(6) = 0x00;         /* memoryAddress[3] */
  req.byte(7) = 0x40;         /* memorySize (0x4000 = 16KB) */
  req.dlc     = 8;
  output(req);
  write("[OTA_Server] UDS 0x34 다운로드 요청 (주소: 0x00010000, 크기: 16KB)");
  setTimer(tResponseTimeout, 5000);
}

/*============================================================
 * Step 4: UDS 0x36 — 데이터 블록 전송
 *============================================================*/
void sendUDS_36(byte blockSeq)
{
  message UDS_Request req;
  req.byte(0) = SID_TRANSFER_DATA;
  req.byte(1) = blockSeq;     /* blockSequenceCounter */
  /* byte(2)~byte(7): 실제 펌웨어 데이터 (시뮬레이션: 0xAA 패턴) */
  req.byte(2) = 0xAA;
  req.byte(3) = 0xBB;
  req.byte(4) = 0xCC;
  req.byte(5) = 0xDD;
  req.byte(6) = 0xEE;
  req.byte(7) = 0xFF;
  req.dlc     = 8;

  @OTA::blockSequenceCounter = blockSeq;
  output(req);
  write("[OTA_Server] UDS 0x36 블록 전송: Block #%d / %d", blockSeq, gTotalBlocks);
  setTimer(tResponseTimeout, 5000);
}

/*============================================================
 * Step 5: UDS 0x37 — 전송 완료 및 CRC 검증 요청
 *============================================================*/
void sendUDS_37()
{
  message UDS_Request req;
  req.byte(0) = SID_REQUEST_EXIT;
  /* CRC-32 체크섬 (시뮬레이션: 0x12345678) */
  req.byte(1) = 0x12;
  req.byte(2) = 0x34;
  req.byte(3) = 0x56;
  req.byte(4) = 0x78;
  req.dlc     = 5;
  output(req);
  write("[OTA_Server] UDS 0x37 전송 완료 — CRC-32 검증 요청");
  setTimer(tResponseTimeout, 5000);
}

/*============================================================
 * Rollback 실행
 *============================================================*/
void triggerRollback()
{
  gRollbackTriggered = 1;
  gOtaState          = 0;
  gOtaInProgress     = 0;
  @OTA::rollbackTriggered = 1;
  @OTA::otaInProgress     = 0;
  write("[OTA_Server] 🔄 Rollback 실행 — 이전 펌웨어로 복구");
}

/*============================================================
 * UDS_Response 수신 처리 — OTA 상태 머신
 *============================================================*/
on message UDS_Response
{
  byte responseCode;
  cancelTimer(tResponseTimeout);
  responseCode = this.byte(0);
  @UDS::lastResponseCode = responseCode;

  switch (gOtaState)
  {
    case 2:   /* Programming Session 응답 대기 */
      if (responseCode == 0x50)
      {
        write("[OTA_Server] ✅ Programming Session 진입 완료");
        gOtaState = 3;
        sendUDS_34();
      }
      else { handleNRC(responseCode, this.byte(2)); }
      break;

    case 3:   /* Download Request 응답 대기 */
      if (responseCode == 0x74)
      {
        gMaxBlockLength = this.byte(2);
        write("[OTA_Server] ✅ 다운로드 허가 — maxBlockLength: %d", gMaxBlockLength);
        gOtaState    = 4;
        gCurrentBlock = 1;
        gBlockSeqCounter = 1;
        setTimer(tBlockTx, 100);
      }
      else { handleNRC(responseCode, this.byte(2)); }
      break;

    case 4:   /* Transfer Data 응답 대기 */
      if (responseCode == 0x76)
      {
        write("[OTA_Server] ✅ 블록 #%d 전송 완료", gCurrentBlock);
        gCurrentBlock++;
        if (gCurrentBlock > gTotalBlocks)
        {
          gOtaState = 5;
          sendUDS_37();
        }
        else
        {
          gBlockSeqCounter = (gBlockSeqCounter + 1) & 0xFF;
          setTimer(tBlockTx, 100);
        }
      }
      else { handleNRC(responseCode, this.byte(2)); }
      break;

    case 5:   /* Transfer Exit 응답 대기 */
      if (responseCode == 0x77)
      {
        gCrcMatch  = 1;
        gOtaState  = 6;
        gOtaInProgress = 0;
        @OTA::crcMatch      = 1;
        @OTA::otaInProgress = 0;
        write("[OTA_Server] ✅ OTA 완료 — CRC-32 검증 통과, BCM 재시작");
      }
      else if (responseCode == 0x7F)
      {
        write("[OTA_Server] ❌ CRC 불일치 — Rollback 실행");
        triggerRollback();
      }
      break;
  }
}

/*============================================================
 * 블록 전송 타이머 (100ms 간격)
 *============================================================*/
on timer tBlockTx
{
  if (gOtaState == 4 && gCurrentBlock <= gTotalBlocks)
    sendUDS_36(gBlockSeqCounter);
}

/*============================================================
 * DoIP 응답 수신 → Programming Session 진입
 *============================================================*/
on message DoIP_RoutingActivation
{
  cancelTimer(tResponseTimeout);
  write("[OTA_Server] ✅ DoIP 경로 활성화 완료");
  gOtaState = 2;
  sendUDS_10_02();
}

/*============================================================
 * NRC (Negative Response Code) 처리
 *============================================================*/
void handleNRC(byte responseCode, byte nrc)
{
  if (responseCode == 0x7F)
  {
    write("[OTA_Server] ❌ NegativeResponse: NRC=0x%02X — Rollback 실행", nrc);
    triggerRollback();
  }
}

/*============================================================
 * 응답 타임아웃 → Rollback
 *============================================================*/
on timer tResponseTimeout
{
  write("[OTA_Server] ⏱ 응답 타임아웃 — Rollback 실행 (State: %d)", gOtaState);
  triggerRollback();
}

/*============================================================
 * Bus Off 감지 → OTA 강제 중단
 *============================================================*/
on busOff
{
  if (gOtaInProgress == 1)
  {
    write("[OTA_Server] ❌ Bus Off 감지 — OTA 강제 중단 및 Rollback");
    triggerRollback();
  }
}
