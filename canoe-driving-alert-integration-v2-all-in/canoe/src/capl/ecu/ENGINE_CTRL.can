/*@!Encoding:949*/
// ENGINE_CTRL_ManualIgnition.can
// ?쒕룞 踰꾪듉?쇰줈 ?섎룞 ?쒖뼱

includes
{
}

variables
{
  msTimer tEngineCycle;
  int gIgnitionState;
  int gEngineState;
  int gLastEngineState;
  int gFuelLevel;
  int gBatterySoc;
}

on start
{
  gIgnitionState   = 0;     // ?쒕룞 爰쇱쭊 ?곹깭濡??쒖옉
  gEngineState     = 0;
  gLastEngineState = -1;
  gFuelLevel       = 80;
  gBatterySoc      = 95;
  setTimer(tEngineCycle, 100);
  write("[ENGINE_CTRL] start - Manual ignition control");
}

on message frmIgnitionEngineMsg
{
  gIgnitionState = this.IgnitionState;
  gEngineState   = this.EngineState;
  if (gIgnitionState < 0 || gIgnitionState > 1) gIgnitionState = 0;
  if (gEngineState   < 0 || gEngineState   > 3) gEngineState   = 0;
}

on timer tEngineCycle
{
  message frmEngineSpeedTempMsg  mSpeedTemp;
  message frmFuelBatteryStateMsg mFuelBat;
  message frmThrottleStateMsg    mThrottle;
  message frmEngineTorqueMsg     mTorque;
  message frmEngineLoadMsg       mLoad;
  message frmThermalMgmtStateMsg mThermal;
  int rpm;
  int throttlePos;
  int engineLoad;
  int torque;
  int speed;
  int ignitionPanel;

  // ==========================================
  // ?쒕룞 踰꾪듉 ?곹깭 ?쎄린
  // ==========================================
  ignitionPanel = (int)@Chassis::ignitionState;
  
  // ?띾룄 ?쎄린
  speed = (int)@Chassis::vehicleSpeed;
  
  // ==========================================
  // ?쒕룞 踰꾪듉???곕Ⅸ ?붿쭊 ?곹깭 ?ㅼ젙
  // ==========================================
  if (ignitionPanel == 0)
  {
    // ?쒕룞 OFF
    gIgnitionState = 0;
    gEngineState = 0;
  }
  else if (ignitionPanel == 1)
  {
    // ?쒕룞 ON
    gIgnitionState = 1;
    
    if (speed > 0)
    {
      // 二쇳뻾 以?      gEngineState = 3;
    }
    else
    {
      // ?뺤? 以?(怨듯쉶??
      gEngineState = 2;
    }
  }
  
  // ==========================================
  // RPM 怨꾩궛
  // ==========================================
  if      (gEngineState == 0) { rpm = 0; }        // ?붿쭊 爰쇱쭚
  else if (gEngineState == 1) { rpm = 400; }      // ?쒕룞 嫄몃┝ 以?  else if (gEngineState == 2) { rpm = 800; }      // 怨듯쉶??  else
  {
    // 二쇳뻾 以? RPM = 800 + (?띾룄 횞 25)
    rpm = 800 + (speed * 25);
    if (rpm > 6500) rpm = 6500;
  }

  throttlePos = (gEngineState == 3) ? speed : 0;
  if (throttlePos > 100) throttlePos = 100;
  engineLoad  = (gEngineState == 3) ? (throttlePos * 8 / 10) : 0;
  if (engineLoad > 100) engineLoad = 100;
  torque      = (gEngineState == 3) ? (engineLoad * 3) : 0;
  if (torque > 300) torque = 300;

  mSpeedTemp.EngineRpm   = rpm & 0xFFFF;
  mSpeedTemp.CoolantTemp = (gEngineState > 0) ? 85 : 20;
  mSpeedTemp.OilTemp     = (gEngineState > 0) ? 90 : 20;
  output(mSpeedTemp);

  mFuelBat.FuelLevel     = gFuelLevel;
  mFuelBat.BatterySoc    = gBatterySoc;
  mFuelBat.ChargingState = 0;
  output(mFuelBat);

  mThrottle.ThrottlePos = throttlePos;
  mThrottle.ThrottleReq = throttlePos;
  output(mThrottle);

  mTorque.EngineTorqueAct = torque & 0xFFFF;
  output(mTorque);

  mLoad.EngineLoad = engineLoad;
  output(mLoad);

  mThermal.ThermalMode   = (gEngineState > 0) ? 1 : 0;
  mThermal.FanDuty       = (gEngineState == 3) ? 8 : 0;
  mThermal.CoolantTarget = 90;
  output(mThermal);

  if (gEngineState != gLastEngineState)
  {
    write("[ENGINE_CTRL] ignition=%d engine=%d rpm=%d speed=%d",
          gIgnitionState, gEngineState, rpm, speed);
    gLastEngineState = gEngineState;
  }

  setTimer(tEngineCycle, 100);
}
