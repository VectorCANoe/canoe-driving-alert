/*@!Encoding:949*/


includes
{
}

variables
{
}

on start
{
  @Chassis::ignitionState = 0;
  write("[IGNITION] start");
}


