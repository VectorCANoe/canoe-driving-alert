/*@!Encoding:949*/
// ACCEL_CTRL_Fixed.can
// Accel + Speed Control
// Chassis namespace

includes
{
}

variables
{
  msTimer tAccelCycle;
  double gSpeed;
  double gThrottlePos;
}

on start
{
  gSpeed = 0.0;
  gThrottlePos = 0.0;
  setTimer(tAccelCycle, 100);
  write("[ACCEL] start");
}

on sysvar Chassis::ignitionState
{
  if (@Chassis::ignitionState == 0)
  {
    gSpeed = 0.0;
    gThrottlePos = 0.0;
    write("[ACCEL] ignition OFF - reset");
  }
}

on sysvar Chassis::throttlePosition
{
  // Block throttle input when ignition is OFF
  if (@Chassis::ignitionState == 0)
  {
    @Chassis::throttlePosition = 0;
  }
}

on sysvar Chassis::brakePressure
{
  // Block brake input when ignition is OFF
  if (@Chassis::ignitionState == 0)
  {
    @Chassis::brakePressure = 0;
  }
}

on timer tAccelCycle
{
  int ignition;
  int driveMode;
  double brakePressure;
  double targetThrottle;
  double speedChange;

  ignition       = (int)@Chassis::ignitionState;
  driveMode      = (int)@Chassis::driveMode;
  brakePressure  = @Chassis::brakePressure;
  targetThrottle = @Chassis::throttlePosition;

  // If ignition is OFF, reset all values and skip
  if (ignition == 0)
  {
    gSpeed = 0.0;
    gThrottlePos = 0.0;
    @Chassis::vehicleSpeed = 0;
    setTimer(tAccelCycle, 100);
    return;
  }

  // Throttle ramp: 0.005% per 100ms
  if (targetThrottle > gThrottlePos)
  {
    gThrottlePos = gThrottlePos + 0.005;
    if (gThrottlePos > targetThrottle) gThrottlePos = targetThrottle;
  }
  else if (targetThrottle < gThrottlePos)
  {
    gThrottlePos = gThrottlePos - 0.005;
    if (gThrottlePos < targetThrottle) gThrottlePos = targetThrottle;
  }

  if (brakePressure > 10)
  {
    // Brake: -15 km/h per sec
    speedChange = 15.0 * 0.1;
    gSpeed = gSpeed - speedChange;
    if (gSpeed < 0.0) gSpeed = 0.0;
  }
  else if (targetThrottle > 0 && (driveMode == 3 || driveMode == 1))
  {
    // Accelerate only while pedal is pressed
    speedChange = (gThrottlePos / 100.0) * 0.3 * 0.1;
    gSpeed = gSpeed + speedChange;
    if (driveMode == 1 && gSpeed > 30.0)  gSpeed = 30.0;
    if (driveMode == 3 && gSpeed > 200.0) gSpeed = 200.0;
  }
  else
  {
    // Coast: 0.003 km/h per 100ms
    speedChange = 0.003;
    gSpeed = gSpeed - speedChange;
    if (gSpeed < 0.0) gSpeed = 0.0;
  }

  @Chassis::vehicleSpeed = (int)gSpeed;

  write("[ACCEL] ign=%d gear=%d thr=%.1f spd=%.1f brk=%.1f",
        ignition, driveMode, gThrottlePos, gSpeed, brakePressure);

  setTimer(tAccelCycle, 100);
}
